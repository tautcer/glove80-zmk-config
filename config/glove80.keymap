/*
 * Copyright (c) 2020 The ZMK Contributors
 * Copyright (c) 2022 Innaworks Development Limited, trading as MoErgo
 *
 * SPDX-License-Identifier: MIT
 */


/* THIS FILE WAS GENERATED BY GLOVE80 LAYOUT EDITOR
 *
 * This file was generated automatically. You may or may not want to
 * edit it directly.
 */

#define HOST_OS 1  // set to 1 for Linux, default is 0 (Windows)
#include <behaviors.dtsi>
#include <dt-bindings/zmk/outputs.h>

/* Include behaviour includes needed by key binds - automatically generated */
#include <dt-bindings/zmk/keys.h>
#include <dt-bindings/zmk/ext_power.h>
#include <dt-bindings/zmk/bt.h>
#include <dt-bindings/zmk/rgb.h>
#include <dt-bindings/zmk/outputs.h>

#include "./zmk-nodefree-config/helper.h"
#include "./zmk-nodefree-config/keypos_def/keypos_glv80.h"

#include "./mouse.dtsi"

#define LEFT_HAND_KEYS   LC5 LC4 LC3 LC2 LC1 \
                         LN5 LN4 LN3 LN2 LN1 LN0 \
                         LT5 LT4 LT3 LT2 LT1 LT0 \
                         LM5 LM4 LM3 LM2 LM1 LM0 \
                         LB5 LB4 LB3 LB2 LB1 LB0 \
                         LF5 LF4 LF3 LF2 LF1

#define RIGHT_HAND_KEYS      RC1 RC2 RC3 RC4 RC5 \
                         RN0 RN1 RN2 RN3 RN4 RN5 \
                         RT0 RT1 RT2 RT3 RT4 RT5 \
                         RM0 RM1 RM2 RM3 RM4 RM5 \
                         RB0 RB1 RB2 RB3 RB4 RB5 \
                             RF1 RF2 RF3 RF4 RF5

#define THUMB_KEYS       LH5 LH4 LH3     RH3 RH4 RH5 \
                         LH2 LH1 LH0     RH0 RH1 RH2

#define UNSET_TIMER  (-1)

#define ALPHA  A B C D E F G H I J K L M N O P \
               Q R S T U V W X Y Z

#define NUMERIC  N0 N1 N2 N3 N4 N5 N6 N7 N8 N9

#ifndef OPERATING_SYSTEM
#define OPERATING_SYSTEM 1 // linux
//#define OPERATING_SYSTEM 2 // macos
//#define OPERATING_SYSTEM 3 // windows
#endif
#if OPERATING_SYSTEM == 2
  #define _C         LG
  #define _REDO      _C(LS(Z))
  #define _POWER     K_POWER
#else
  #define _C         LC
  #define _REDO      _C(Y)
  #define _POWER     C_POWER
#endif
#define   _SLEEP     C_SLEEP
#if OPERATING_SYSTEM == 3
  #define _LOCK      LG(L)
#elif OPERATING_SYSTEM == 2
  #define _LOCK      _C(LC(Q))
#elif OPERATING_SYSTEM == 1
  #define _LOCK      K_LOCK
#endif
#define   _UNDO      _C(Z)
#define   _CUT       _C(X)
#define   _COPY      _C(C)
#define   _PASTE     _C(V)
#define   _FIND      _C(F)
#define   _FIND_NEXT _C(G)
#define   _FIND_PREV _C(LS(G))

#define MAKE_HRMS(name, hold_tap_flavor, ...) \
    ZMK_BEHAVIOR(hml_ ## name, hold_tap, \
        flavor = hold_tap_flavor; \
        bindings = <&kp>, <&kp>; \
        hold-trigger-key-positions = <RIGHT_HAND_KEYS THUMB_KEYS>; \
        __VA_ARGS__ \
    ) \
    ZMK_BEHAVIOR(hmr_ ## name, hold_tap, \
        flavor = hold_tap_flavor; \
        bindings = <&kp>, <&kp>; \
        hold-trigger-key-positions = <LEFT_HAND_KEYS THUMB_KEYS>; \
        __VA_ARGS__ \
    )


&sk {  // sticky-key config
    quick-release;
};

&caps_word {  // caps word config, requires PR #1742
    no-default-keys;
    continue-list = <ALPHA NUMERIC UNDERSCORE MINUS BACKSPACE DELETE>;
    shift-list = <ALPHA>;
};

/* Custom behaviors/combos/layers */

MAKE_HRMS(homes, "balanced",
    hold-trigger-on-release;  // wait for other home row mods
    tapping-term-ms = <280>;
    quick-tap-ms = <175>;
    require-prior-idle-ms = <150>;
)

MAKE_HRMS(shift, "tap-preferred",
    tapping-term-ms = <240>;
    quick-tap-ms = <300>;
    require-prior-idle-ms = <150>;
)

ZMK_BEHAVIOR(thumb, hold_tap,
    flavor = "balanced";
    bindings = <&mo>, <&kp>;
    tapping-term-ms = <200>;
    quick-tap-ms = <300>;
    // no typing streak
)

ZMK_BEHAVIOR(space, hold_tap,
    flavor = "balanced";
    bindings = <&mo>, <&kp>;
    tapping-term-ms = <170>;
    quick-tap-ms = <200>;
    // no typing streak
    retro-tap; // allow slow (hold-like) taps
)

// tap: sticky-shift | shift + tap/ double-tap: caps-word | hold: shift
ZMK_BEHAVIOR(smart_shft, mod_morph,
    bindings = <&sk LSHFT>, <&caps_word>;
    mods = <(MOD_LSFT)>;
)

// comma, semicolon swapper
ZMK_BEHAVIOR(comma_semi, mod_morph,
    bindings = <&kp COMMA>, <&kp SEMI>;
    mods = <(MOD_LSFT|MOD_RSFT)>;
)

// dot, colon swapper
ZMK_BEHAVIOR(dot_colon, mod_morph,
    bindings = <&kp DOT>, <&kp COLON>;
    mods = <(MOD_LSFT|MOD_RSFT)>;
)

// excl, question mark swapper
ZMK_BEHAVIOR(question_excl, mod_morph,
    bindings = <&kp QMARK>, <&kp EXCL>;
    mods = <(MOD_LSFT|MOD_RSFT)>;
)

ZMK_BEHAVIOR(copy_sel_all_pc, mod_morph,
    bindings = <&kp LC(C)>, <&kp LC(A)>;
    mods = <(MOD_LALT|MOD_RALT)>;
)

ZMK_BEHAVIOR(paste_undo_pc, mod_morph,
    bindings = <&kp LC(V)>, <&kp LC(Z)>;
    mods = <(MOD_LALT|MOD_RALT)>;
)

/* Standard Glove80 behaviors and macros */

// For the "layer" key, it'd nice to be able to use it as either a shift or a toggle.
// Configure it as a tap dance, so the first tap (or hold) is a &mo and the second tap is a &to
ZMK_BEHAVIOR(lower, tap_dance,
    bindings = <&mo 1>, <&to 1>;
    tapping-term-ms = <200>;
)

ZMK_BEHAVIOR(magic, hold_tap,
    flavor = "tap-preferred";
    bindings = <&mo>, <&rgb_ug_status_macro>;
    tapping-term-ms = <200>;
)

ZMK_BEHAVIOR(rgb_ug_status_macro, macro,
    bindings = <&rgb_ug RGB_STATUS>;
)

ZMK_BEHAVIOR(bt_sel, macro_one_param,
    bindings = <&out OUT_BLE>, <&macro_param_1to2>, <&bt BT_SEL MACRO_PLACEHOLDER>;
)

ZMK_UNICODE_SINGLE(pound, N0, N0, A, N3)  // £: U+00A3

/ {
    macros {

        //
        // select a word (jumps to next word upon each successive invocation)
        //
        select_word: select_word {
            compatible = "zmk,behavior-mod-morph";
            label = "SELECT_WORD";
            #binding-cells = <0>;
            bindings = <&select_word_right>, <&select_word_left>;
            mods = <(MOD_LSFT|MOD_RSFT)>;
        };

        ZMK_MACRO(select_word_right,
            wait-ms = <1>;
            tap-ms = <1>;
            bindings = <&kp _C(RIGHT) &kp _C(LEFT) &kp _C(LS(RIGHT))>;
        )

        ZMK_MACRO(select_word_left,
            wait-ms = <1>;
            tap-ms = <1>;
            bindings = <&kp _C(LEFT) &kp _C(RIGHT) &kp _C(LS(LEFT))>;
        )

        //
        // extend current selection by one word
        //
        extend_word: extend_word {
            compatible = "zmk,behavior-mod-morph";
            label = "EXTEND_WORD";
            #binding-cells = <0>;
            bindings = <&extend_word_right>, <&extend_word_left>;
            mods = <(MOD_LSFT|MOD_RSFT)>;
        };

        ZMK_MACRO(extend_word_right,
            wait-ms = <1>;
            tap-ms = <1>;
            bindings = <&kp _C(LS(RIGHT))>;
        )

        ZMK_MACRO(extend_word_left,
            wait-ms = <1>;
            tap-ms = <1>;
            bindings = <&kp _C(LS(LEFT))>;
        )
    };
};

#define XXX  &none
#define ___  &trans

#define BASE    0
#define LOWER   1
#define SYMBOL  2
#define MOUSE   3
#define MAGIC   4
#define TYPING  5
#define NUMBERS 6
#define QWERTY  7

#define TO_MAGIC  &magic MAGIC 0
#define SCRNSHT   &kp LG(LS(N4))

// Temporary testing some combos
#define COMBO_TERM_FAST 18
#define COMBO_TERM_SLOW 30

#define COMBO_IDLE_FAST 150
#define COMBO_IDLE_SLOW 50

ZMK_COMBO(lbkt,  &kp LBKT,     RB1 RB2,     BASE     NUMBERS, COMBO_TERM_FAST, COMBO_IDLE_FAST)
ZMK_COMBO(rbkt,  &kp RBKT,     RB2 RB3,     BASE     NUMBERS, COMBO_TERM_FAST, COMBO_IDLE_FAST)
ZMK_COMBO(lbrc,  &kp LBRC,     RB1 RB2,         SYMBOL    , COMBO_TERM_FAST, COMBO_IDLE_FAST)
ZMK_COMBO(rbrc,  &kp RBRC,     RB2 RB3,         SYMBOL    , COMBO_TERM_FAST, COMBO_IDLE_FAST)

GLV80_LAYER(Base,
// ╭───────────────┬────────────────────┬───────────────────┬───────────────────┬─────────────────────╮                     ╭─────────────────────┬───────────────────┬─────────────────────┬───────────────────────┬───────────╮
     &kp C_BRI_DN    &kp C_BRI_UP         &kp C_PREV          &kp C_PP            &kp C_NEXT                                  &kp C_MUTE            &kp C_VOL_DN        &kp C_VOL_UP          &kp F9                  SCRNSHT
// ├───────────────┼────────────────────┼───────────────────┼───────────────────┼─────────────────────┼────────╮   ╭────────┼─────────────────────┼───────────────────┼─────────────────────┼───────────────────────┼───────────┤
     &kp GRAVE       &kp N1               &kp N2              &kp N3              &kp N4                &kp N5       &kp N6   &kp N7                &kp N8              &kp N9                &kp N0                  &kp MINUS
// ├───────────────┼────────────────────┼───────────────────┼───────────────────┼─────────────────────┼────────┤   ├────────┼─────────────────────┼───────────────────┼─────────────────────┼───────────────────────┼───────────┤
     &kp TAB         &kp Q                &kp W               &kp F               &kp P                 &kp B        &kp J    &kp L                 &kp U               &kp Y                 &kp SQT                 &kp BSLH
// ├───────────────┼────────────────────┼───────────────────┼───────────────────┼─────────────────────┼────────┤   ├────────┼─────────────────────┼───────────────────┼─────────────────────┼───────────────────────┼───────────┤
     &kp ESC         &hml_homes LCTRL A   &hml_homes LALT R   &hml_homes LGUI S   &hml_shift LSHIFT T   &kp G        &kp M    &hmr_shift RSHIFT N   &hmr_homes RGUI E   &hmr_homes LALT I     &hmr_homes RCTRL O      &kp SQT
// ├───────────────┼────────────────────┼───────────────────┼───────────────────┼─────────────────────┼────────┤   ├────────┼─────────────────────┼───────────────────┼─────────────────────┼───────────────────────┼───────────┤
     &kp GRAVE       &kp Z                &kp X               &kp C               &kp D                 &kp V    ,   &kp K    &kp H                 &comma_semi         &dot_colon            &question_excl          &kp EQUAL
// ├───────────────┼────────────────────┼───────────────────┼───────────────────┼─────────────────────┼────────╯   ╰────────┼─────────────────────┼───────────────────┼─────────────────────┼───────────────────────┼───────────┤
     TO_MAGIC        &kp HOME             &kp END             &kp LEFT            &kp RIGHT                      ,            &kp DOWN              &kp UP              &kp RBKT              &kp RPAR                &kp PG_DN
// ╰───────────────┴────────────────────┴───────────────────┴───────────────────┴─────────────────────╯                     ╰─────────────────────┴───────────────────┴─────────────────────┴───────────────────────┴───────────╯
                                                                                                                 ,
//                                               ╭──────────────────────────┬──────────────────┬────────────╮         ╭───────────┬───────────────────┬─────────────────────╮
                                                   &caps_word                 XXX                &lower                 &kp DEL     XXX                 &caps_word
/*                                               ├──────────────────────────┼──────────────────┼────────────┤ */ , /* ├───────────┼───────────────────┼─────────────────────┤ */
                                                   &thumb NUMBERS BACKSPACE   &kp TAB            XXX                    &to MOUSE   &kp RET             &space SYMBOL SPACE
//                                               ╰──────────────────────────┴──────────────────┴────────────╯         ╰───────────┴───────────────────┴─────────────────────╯
)

GLV80_LAYER(Lower,
// ╭──────────┬───────────┬──────────┬──────────┬────────────╮                            ╭──────────┬────────┬───────────┬────────┬─────────╮
     &kp F1     &kp F2      &kp F3     &kp F4     &kp F5                                    &kp F6     &kp F7   &kp F8      &kp F9   &kp F10
// ├──────────┼───────────┼──────────┼──────────┼────────────┼─────────────╮   ╭──────────┼──────────┼────────┼───────────┼────────┼─────────┤
     ___        ___         ___        ___        ___          ___               ___        ___        ___      ___         ___      ___
// ├──────────┼───────────┼──────────┼──────────┼────────────┼─────────────┤   ├──────────┼──────────┼────────┼───────────┼────────┼─────────┤
     ___        ___         ___        ___        ___          &tog TYPING       ___        ___        ___      ___         ___      ___
// ├──────────┼───────────┼──────────┼──────────┼────────────┼─────────────┤   ├──────────┼──────────┼────────┼───────────┼────────┼─────────┤
     ___        ___         ___        ___        &kp LSHIFT   &tog QWERTY       &kp LEFT   &kp DOWN   &kp UP   &kp RIGHT   ___      ___
// ├──────────┼───────────┼──────────┼──────────┼────────────┼─────────────┤   ├──────────┼──────────┼────────┼───────────┼────────┼─────────┤
     ___        ___         ___        ___        ___          ___           ,   ___        ___        ___      ___         ___      ___
// ├──────────┼───────────┼──────────┼──────────┼────────────┼─────────────╯   ╰──────────┼──────────┼────────┼───────────┼────────┼─────────┤
     ___        ___         ___        ___        ___                        ,              ___        ___      ___         ___      ___
// ╰──────────┴───────────┴──────────┴──────────┴────────────╯                            ╰──────────┴────────┴───────────┴────────┴─────────╯
                                                                             ,
//                                           ╭────────┬────────┬────────╮         ╭────────┬─────────┬────────╮
                                               ___      ___      ___                ___      ___       ___
/*                                           ├────────┼────────┼────────┤ */ , /* ├────────┼─────────┼────────┤ */
                                               ___      XXX      ___                ___      &kp DEL   ___
//                                           ╰────────┴────────┴────────╯         ╰────────┴─────────┴────────╯
)

GLV80_LAYER(Symbol,
// ╭────────────┬────────────┬────────────┬────────────┬────────────╮                             ╭────────────┬─────────────┬────────────┬────────────┬────────────╮
     XXX          XXX          XXX          XXX          XXX                                        XXX          XXX           XXX          XXX          XXX
// ├────────────┼────────────┼────────────┼────────────┼────────────┼────────────╮   ╭────────────┼────────────┼─────────────┼────────────┼────────────┼────────────┤
     &pound       &kp GRAVE    &kp LPAR     &kp RPAR     &kp SEMI     &kp COMMA        XXX          XXX          XXX           XXX          XXX          XXX
// ├────────────┼────────────┼────────────┼────────────┼────────────┼────────────┤   ├────────────┼────────────┼─────────────┼────────────┼────────────┼────────────┤
     &kp EXCL     &kp LBRC     &kp SQT      &kp DQT      &kp RBRC     &kp QMARK        XXX          &kp RSHIFT   &kp RGUI      &kp LALT     &kp RCTRL    XXX
// ├────────────┼────────────┼────────────┼────────────┼────────────┼────────────┤   ├────────────┼────────────┼─────────────┼────────────┼────────────┼────────────┤
     &kp HASH     &kp CARET    &kp EQUAL    &kp UNDER    &kp DLLR     &kp STAR         XXX          &kp BSPC     &kp TAB       &kp SPACE    &kp ENTER    XXX
// ├────────────┼────────────┼────────────┼────────────┼────────────┼────────────┤   ├────────────┼────────────┼─────────────┼────────────┼────────────┼────────────┤
     &kp TILDE    &kp LT       &kp PIPE     &kp MINUS    &kp GT       &kp FSLH     ,   XXX          &kp DEL      &kp LS(TAB)   XXX          XXX          XXX
// ├────────────┼────────────┼────────────┼────────────┼────────────┼────────────╯   ╰────────────┼────────────┼─────────────┼────────────┼────────────┼────────────┤
     &kp AT       &kp AMPS     &kp LBKT     &kp RBKT    &kp PLUS                  ,                XXX          XXX           XXX          XXX          XXX
// ╰────────────┴────────────┴────────────┴────────────┴────────────╯                             ╰────────────┴─────────────┴────────────┴────────────┴────────────╯
                                                                                   ,
//                                   ╭────────────┬────────────┬──────────────╮         ╭────────────┬────────────┬────────────╮
                                       &kp BSLH     &kp DOT      &kp STAR                  XXX          XXX          XXX
/*                                   ├────────────┼────────────┼──────────────┤ */ , /* ├────────────┼────────────┼────────────┤ */
                                       &kp PRCNT    &kp COLON    &kp SEMI                  XXX          XXX          XXX
//                                   ╰────────────┴────────────┴──────────────╯         ╰────────────┴────────────┴────────────╯
)

GLV80_LAYER(Mouse,
// ╭────────┬───────────┬──────────┬──────────┬────────────╮                     ╭────────────────┬────────────────┬─────────────────┬────────┬────────╮
     XXX      XXX         XXX        XXX        XXX                                XXX              XXX              XXX               XXX      XXX
// ├────────┼───────────┼──────────┼──────────┼────────────┼────────╮   ╭────────┼────────────────┼────────────────┼─────────────────┼────────┼────────┤
     XXX      XXX         XXX        XXX        XXX          XXX          XXX      XXX              XXX              XXX               XXX      XXX
// ├────────┼───────────┼──────────┼──────────┼────────────┼────────┤   ├────────┼────────────────┼────────────────┼─────────────────┼────────┼────────┤
     XXX      XXX         XXX        XXX        XXX          XXX          XXX      XXX              &mmv MOVE_UP     &msc SCRL_UP      XXX      XXX
// ├────────┼───────────┼──────────┼──────────┼────────────┼────────┤   ├────────┼────────────────┼────────────────┼─────────────────┼────────┼────────┤
     XXX      &kp LCTRL   &kp LALT   &kp LGUI   &kp LSHIFT   XXX          XXX      &mmv MOVE_LEFT   &mmv MOVE_DOWN   &mmv MOVE_RIGHT   XXX      XXX
// ├────────┼───────────┼──────────┼──────────┼────────────┼────────┤   ├────────┼────────────────┼────────────────┼─────────────────┼────────┼────────┤
     XXX      XXX         XXX        XXX        XXX          XXX      ,   XXX      XXX              XXX              &msc SCRL_DOWN    XXX      XXX
// ├────────┼───────────┼──────────┼──────────┼────────────┼────────╯   ╰────────┼────────────────┼────────────────┼─────────────────┼────────┼────────┤
     XXX      XXX         XXX        XXX        XXX                   ,            XXX              XXX              XXX               XXX      XXX
// ╰────────┴───────────┴──────────┴──────────┴────────────╯                     ╰────────────────┴────────────────┴─────────────────┴────────┴────────╯
                                                                      ,
//                                    ╭────────┬────────┬────────╮         ╭──────────┬──────────┬──────────╮
                                        XXX      XXX      XXX                XXX        XXX        XXX
/*                                    ├────────┼────────┼────────┤ */ , /* ├──────────┼──────────┼──────────┤ */
                                        XXX      XXX      XXX                &to BASE   &mkp MB2   &mkp MB1
//                                    ╰────────┴────────┴────────╯         ╰──────────┴──────────┴──────────╯
)

GLV80_LAYER(Magic,
// ╭─────────────┬─────────────────┬─────────────────┬─────────────────┬─────────────────╮                             ╭───────┬───────┬───────┬───────┬────────────────╮
     &bt BT_CLR    XXX               XXX               XXX               XXX                                             XXX     XXX     XXX     XXX     &bt BT_CLR_ALL
// ├─────────────┼─────────────────┼─────────────────┼─────────────────┼─────────────────┼─────────────────╮   ╭───────┼───────┼───────┼───────┼───────┼────────────────┤
     XXX           XXX               XXX               XXX               XXX               XXX                   XXX     XXX     XXX     XXX     XXX     XXX
// ├─────────────┼─────────────────┼─────────────────┼─────────────────┼─────────────────┼─────────────────┤   ├───────┼───────┼───────┼───────┼───────┼────────────────┤
     XXX           &rgb_ug RGB_SPI   &rgb_ug RGB_SAI   &rgb_ug RGB_HUI   &rgb_ug RGB_BRI   &rgb_ug RGB_TOG       XXX     XXX     XXX     XXX     XXX     XXX
// ├─────────────┼─────────────────┼─────────────────┼─────────────────┼─────────────────┼─────────────────┤   ├───────┼───────┼───────┼───────┼───────┼────────────────┤
     &bootloader   &rgb_ug RGB_SPD   &rgb_ug RGB_SAD   &rgb_ug RGB_HUD   &rgb_ug RGB_BRD   &rgb_ug RGB_EFF       XXX     XXX     XXX     XXX     XXX     &bootloader
// ├─────────────┼─────────────────┼─────────────────┼─────────────────┼─────────────────┼─────────────────┤   ├───────┼───────┼───────┼───────┼───────┼────────────────┤
     &sys_reset    XXX               XXX               XXX               XXX               XXX               ,   XXX     XXX     XXX     XXX     XXX     &sys_reset
// ├─────────────┼─────────────────┼─────────────────┼─────────────────┼─────────────────┼─────────────────╯   ╰───────┼───────┼───────┼───────┼───────┼────────────────┤
     XXX           XXX               XXX               XXX               XXX                                 ,           XXX     XXX     XXX     XXX     XXX
// ╰─────────────┴─────────────────┴─────────────────┴─────────────────┴─────────────────╯                             ╰───────┴───────┴───────┴───────┴────────────────╯
                                                                                                             ,
//                                                               ╭───────────┬───────────┬──────────────╮         ╭───────┬───────┬───────╮
                                                                   &bt_sel 2   &bt_sel 3   XXX                      XXX     XXX     XXX
/*                                                               ├───────────┼───────────┼──────────────┤ */ , /* ├───────┼───────┼───────┤ */
                                                                   &bt_sel 0   &bt_sel 1   &out OUT_USB             XXX     XXX     XXX
//                                                               ╰───────────┴───────────┴──────────────╯         ╰───────┴───────┴───────╯
)

GLV80_LAYER(Typing,
// ╭───────────────┬────────────────────┬───────────────────┬───────────────────┬─────────────────────╮                     ╭─────────────────────┬───────────────────┬─────────────────────┬───────────────────────┬───────────╮
     ___             ___                  ___                 ___                 ___                                         ___                   ___                 ___                   ___                     ___
// ├───────────────┼────────────────────┼───────────────────┼───────────────────┼─────────────────────┼────────╮   ╭────────┼─────────────────────┼───────────────────┼─────────────────────┼───────────────────────┼───────────┤
     &kp GRAVE       &kp N1               &kp N2              &kp N3              &kp N4                &kp N5       &kp N6   &kp N7                &kp N8              &kp N9                &kp N0                  &kp MINUS
// ├───────────────┼────────────────────┼───────────────────┼───────────────────┼─────────────────────┼────────┤   ├────────┼─────────────────────┼───────────────────┼─────────────────────┼───────────────────────┼───────────┤
     &kp TAB         &kp Q                &kp W               &kp F               &kp P                 &kp B        &kp J    &kp L                 &kp U               &kp Y                 &kp SEMI                &kp BSLH
// ├───────────────┼────────────────────┼───────────────────┼───────────────────┼─────────────────────┼────────┤   ├────────┼─────────────────────┼───────────────────┼─────────────────────┼───────────────────────┼───────────┤
     &mt LCTRL ESC   &kp A                &kp R               &kp S               &kp T                 &kp G        &kp M    &kp N                 &kp E               &kp I                 &kp O                   &kp SQT
// ├───────────────┼────────────────────┼───────────────────┼───────────────────┼─────────────────────┼────────┤   ├────────┼─────────────────────┼───────────────────┼─────────────────────┼───────────────────────┼───────────┤
     &kp GRAVE       &kp Z                &kp X               &kp C               &kp D                 &kp V    ,   &kp K    &kp H                 &comma_semi         &dot_colon            &question_excl          &kp EQUAL
// ├───────────────┼────────────────────┼───────────────────┼───────────────────┼─────────────────────┼────────╯   ╰────────┼─────────────────────┼───────────────────┼─────────────────────┼───────────────────────┼───────────┤
     ___             ___                  ___                 ___                 ___                            ,             ___                  ___                  ___                   ___                     ___
// ╰───────────────┴────────────────────┴───────────────────┴───────────────────┴─────────────────────╯                     ╰─────────────────────┴───────────────────┴─────────────────────┴───────────────────────┴───────────╯
                                                                                                                 ,
//                                                                   ╭────────────┬────────────┬────────────╮         ╭────────────┬────────────┬────────────╮
                                                                       ___          ___          ___                    ___          ___          ___
/*                                                                   ├────────────┼────────────┼────────────┤ */ , /* ├────────────┼────────────┼────────────┤ */
                                                                      &kp BACKSPACE ___          ___                    &to BASE     ___          &kp SPACE
//                                                                   ╰────────────┴────────────┴────────────╯         ╰────────────┴────────────┴────────────╯
)

GLV80_LAYER(Numbers,
// ╭───────────────┬────────────────────┬───────────────────┬───────────────────┬─────────────────────╮                               ╭─────────────────────┬───────────────────┬─────────────────────┬───────────────────────┬───────────╮
     ___             ___                  ___                 ___                 ___                                                    ___                   ___                 ___                   ___                     ___
// ├───────────────┼────────────────────┼───────────────────┼───────────────────┼─────────────────────┼──────────────────╮   ╭────────┼─────────────────────┼───────────────────┼─────────────────────┼───────────────────────┼───────────┤
     ___             ___                  ___                 ___                 ___                   ___                    ___       ___                  ___                  ___                   ___                     ___
// ├───────────────┼────────────────────┼───────────────────┼───────────────────┼─────────────────────┼──────────────────┤   ├────────┼─────────────────────┼───────────────────┼─────────────────────┼───────────────────────┼───────────┤
     ___             ___                  ___                 ___                 &kp BACKSPACE         &kp _CUT               &kp PRCNT &kp N7               &kp N8               &kp N9                &kp COLON               ___
// ├───────────────┼────────────────────┼───────────────────┼───────────────────┼─────────────────────┼──────────────────┤   ├────────┼─────────────────────┼───────────────────┼─────────────────────┼───────────────────────┼───────────┤
     &mt LCTRL ESC   &kp LCTRL            &kp LALT            &kp LGUI            &kp LSHIFT            &copy_sel_all_pc       &kp PLUS  &kp N4               &kp N5               &kp N6                &kp MINUS               ___
// ├───────────────┼────────────────────┼───────────────────┼───────────────────┼─────────────────────┼──────────────────┤   ├────────┼─────────────────────┼───────────────────┼─────────────────────┼───────────────────────┼───────────┤
     ___             ___                  &extend_word        &select_word        &sk _C(A)             &paste_undo_pc     ,   &kp STAR  &kp N1               &kp N2               &kp N3                &kp FSLH                ___
// ├───────────────┼────────────────────┼───────────────────┼───────────────────┼─────────────────────┼──────────────────╯   ╰────────┼─────────────────────┼───────────────────┼─────────────────────┼───────────────────────┼───────────┤
     ___             ___                  ___                 ___                 ___                                      ,             ___                  ___                  ___                   ___                     ___
// ╰───────────────┴────────────────────┴───────────────────┴───────────────────┴─────────────────────╯                               ╰─────────────────────┴───────────────────┴─────────────────────┴───────────────────────┴───────────╯
                                                                                                                           ,
//                                                                             ╭────────────┬────────────┬────────────╮         ╭────────────┬────────────┬────────────╮
                                                                                 ___          ___          ___                    &kp EQUAL    &kp LT       &kp GT
/*                                                                             ├────────────┼────────────┼────────────┤ */ , /* ├────────────┼────────────┼────────────┤ */
                                                                                 ___          ___          ___                    &kp COMMA    &kp DOT      &kp N0
//                                                                             ╰────────────┴────────────┴────────────╯         ╰────────────┴────────────┴────────────╯
)

GLV80_LAYER(Qwerty,
// ╭───────────────┬────────────────────┬───────────────────┬───────────────────┬─────────────────────╮                     ╭─────────────────────┬───────────────────┬─────────────────────┬───────────────────────┬───────────╮
     &kp C_BRI_DN    &kp C_BRI_UP         &kp C_PREV          &kp C_PP            &kp C_NEXT                                  &kp C_MUTE            &kp C_VOL_DN        &kp C_VOL_UP          &kp F9                  SCRNSHT
// ├───────────────┼────────────────────┼───────────────────┼───────────────────┼─────────────────────┼────────╮   ╭────────┼─────────────────────┼───────────────────┼─────────────────────┼───────────────────────┼───────────┤
     &kp GRAVE       &kp N1               &kp N2              &kp N3              &kp N4                &kp N5       &kp N6   &kp N7                &kp N8              &kp N9                &kp N0                  &kp MINUS
// ├───────────────┼────────────────────┼───────────────────┼───────────────────┼─────────────────────┼────────┤   ├────────┼─────────────────────┼───────────────────┼─────────────────────┼───────────────────────┼───────────┤
     &kp TAB         &kp Q                &kp W               &kp E               &kp R                 &kp T        &kp Y    &kp U                 &kp I               &kp O                 &kp P                   &kp BSLH
// ├───────────────┼────────────────────┼───────────────────┼───────────────────┼─────────────────────┼────────┤   ├────────┼─────────────────────┼───────────────────┼─────────────────────┼───────────────────────┼───────────┤
     &kp ESC         &kp A                &kp S               &kp D               &kp F                 &kp G        &kp H    &kp J                 &kp K               &kp L                 &kp SEMI                &kp SQT
// ├───────────────┼────────────────────┼───────────────────┼───────────────────┼─────────────────────┼────────┤   ├────────┼─────────────────────┼───────────────────┼─────────────────────┼───────────────────────┼───────────┤
     &kp GRAVE       &kp Z                &kp X               &kp C               &kp V                 &kp B    ,   &kp N    &kp M                 &kp COMMA           &kp DOT               &kp FSLH                &kp EQUAL
// ├───────────────┼────────────────────┼───────────────────┼───────────────────┼─────────────────────┼────────╯   ╰────────┼─────────────────────┼───────────────────┼─────────────────────┼───────────────────────┼───────────┤
     TO_MAGIC        &kp HOME             &kp END             &kp LEFT            &kp RIGHT                      ,            &kp LPAR              &kp LBKT            &kp RBKT              &kp RPAR                &kp PG_DN
// ╰───────────────┴────────────────────┴───────────────────┴───────────────────┴─────────────────────╯                     ╰─────────────────────┴───────────────────┴─────────────────────┴───────────────────────┴───────────╯
                                                                                                                 ,
//                                                                   ╭────────────┬────────────┬────────────╮         ╭────────────┬────────────┬────────────╮
                                                                       ___          ___          ___                    ___          ___          ___
/*                                                                   ├────────────┼────────────┼────────────┤ */ , /* ├────────────┼────────────┼────────────┤ */
                                                                      &kp BACKSPACE ___          ___                    &to BASE     ___          &kp SPACE
//                                                                   ╰────────────┴────────────┴────────────╯         ╰────────────┴────────────┴────────────╯
)

// GLV80_LAYER(label,
// // ╭────────────┬────────────┬────────────┬────────────┬────────────╮                             ╭────────────┬────────────┬────────────┬────────────┬────────────╮
//      XXX          XXX          XXX          XXX          XXX                                        XXX          XXX          XXX          XXX          XXX
// // ├────────────┼────────────┼────────────┼────────────┼────────────┼────────────╮   ╭────────────┼────────────┼────────────┼────────────┼────────────┼────────────┤
//      XXX          XXX          XXX          XXX          XXX          XXX              XXX          XXX          XXX          XXX          XXX          XXX
// // ├────────────┼────────────┼────────────┼────────────┼────────────┼────────────┤   ├────────────┼────────────┼────────────┼────────────┼────────────┼────────────┤
//      XXX          XXX          XXX          XXX          XXX          XXX              XXX          XXX          XXX          XXX          XXX          XXX
// // ├────────────┼────────────┼────────────┼────────────┼────────────┼────────────┤   ├────────────┼────────────┼────────────┼────────────┼────────────┼────────────┤
//      XXX          XXX          XXX          XXX          XXX          XXX              XXX          XXX          XXX          XXX          XXX          XXX
// // ├────────────┼────────────┼────────────┼────────────┼────────────┼────────────┤   ├────────────┼────────────┼────────────┼────────────┼────────────┼────────────┤
//      XXX          XXX          XXX          XXX          XXX          XXX          ,   XXX          XXX          XXX          XXX          XXX          XXX
// // ├────────────┼────────────┼────────────┼────────────┼────────────┼────────────╯   ╰────────────┼────────────┼────────────┼────────────┼────────────┼────────────┤
//      XXX          XXX          XXX          XXX          XXX                       ,                XXX          XXX          XXX          XXX          XXX
// // ╰────────────┴────────────┴────────────┴────────────┴────────────╯                             ╰────────────┴────────────┴────────────┴────────────┴────────────╯
//                                                                                    ,
// //                                     ╭────────────┬────────────┬────────────╮         ╭────────────┬────────────┬────────────╮
//                                          XXX          XXX          XXX                    XXX          XXX          XXX
// /*                                     ├────────────┼────────────┼────────────┤ */ , /* ├────────────┼────────────┼────────────┤ */
//                                          XXX          XXX          XXX                    XXX          XXX          XXX
// //                                     ╰────────────┴────────────┴────────────╯         ╰────────────┴────────────┴────────────╯
// )
